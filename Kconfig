## Kconfig
```kconfig
# Kconfig - nvblock
#
# Copyright (c) 2019 Laczen
#
# SPDX-License-Identifier: Apache-2.0
#

config NVBLOCK
	bool "Block type interface for non volatile memory"
	help
	  Enable support of NVBLOCK.
```

## zephyr/Kconfig
```kconfig
# Copyright (c) 2022 Laczen
#
# SPDX-License-Identifier: Apache-2.0
#

mainmenu "nvblock configuration"

menu "nvblock settings"

config NVBLOCK
	bool "Enable nvblock"

endmenu

rsource "drivers/Kconfig"
```

## zephyr/drivers/disk/Kconfig.nvblock
```kconfig
# Copyright (c) 2022 Laczen
# SPDX-License-Identifier: Apache-2.0

config DISK_DRIVER_NVBLOCK
	bool "NVBlock"
        select NVBLOCK
	select FLASH
	help
	  NVBlock device is used for the file system.

if DISK_DRIVER_NVBLOCK

module = NVBLOCKDISK
module-str = nvblockdisk
source "subsys/logging/Kconfig.template.log_config"

endif # DISK_DRIVER_NVBLOCK
```

## zephyr/dts/bindings/disk/zephyr,nvblock-disk.yaml
```yaml
# Copyright (c) 2023 Laczen
# SPDX-License-Identifier: Apache-2.0

description: Disk on nvblock device

compatible: "zephyr,nvblock-disk"

include: base.yaml

properties:
  partition:
    type: phandle
    required: true
    description: |
      Backing storage flash partition.

  disk-name:
    type: string
    required: true
    description: |
      Disk name.

  sector-size:
    type: int
    default: 512
    description: |
      nvblock sector size in bytes.
  
  erase-block-size:
    type: int
    default: 4096
    description: |
      nvblock erase-block size in bytes.

  spare-size:
    type: int
    default: 4096
    description: |
      nvblock spare size in bytes.

  blocks-per-group:
    type: int
    default: 8
    description: |
      nvblock blocks (sectors) per group. At the end of each group a meta page
      is written to the backend.  
```
